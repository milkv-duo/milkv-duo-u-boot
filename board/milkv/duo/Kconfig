## board/milkv/duo/Kconfig
```kconfig
if TARGET_MILKV_DUO

config SYS_BOARD
	default "duo"

config SYS_VENDOR
	default "milkv"

config SYS_CPU
	default "cv1800b"

config SYS_CONFIG_NAME
	default "cv180x-asic"

config TEXT_BASE
	default 0x80200000

config CVITEK_SPI_FLASH
    bool
	prompt "Support CVITEK SPINOR"
    select SPI_FLASH
	select DM
	select DM_SPI
	select DM_SPI_FLASH
	select SPI_MEM
	select CMD_SF
    select CVI_SPIF
    select ENV_IS_IN_SPI_FLASH

config ENV_SIZE
    default 0x10000 if ENV_IS_IN_SPI_FLASH
    default 0x20000 if ENV_IS_IN_MMC
	default 0x20000 if ENV_IS_IN_NAND

config ENV_SECT_SIZE
	default 0x10000 if ENV_IS_IN_SPI_FLASH
	default 0x40000 if ENV_IS_IN_MMC
	default 0x20000 if ENV_IS_IN_NAND

config ENV_OFFSET
    default 0x3A0000 if ENV_IS_IN_SPI_FLASH
    default 0x880000 if ENV_IS_IN_MMC
	default 0xae0000 if ENV_IS_IN_NAND

config ENV_OFFSET_REDUND
    default 0x3B0000 if ENV_IS_IN_SPI_FLASH
	default 0xb00000 if ENV_IS_IN_NAND

config BOARD_SPECIFIC_OPTIONS
	def_bool y
	select RISCV_CVITEK
	select SOPHGO_CV1800B
	select CPU
	select CPU_RISCV

endif
```

## configs/milkv_duo_defconfig
```kconfig
CONFIG_RISCV=y
CONFIG_SYS_MALLOC_F_LEN=0x2000
CONFIG_NR_DRAM_BANKS=1
CONFIG_HAS_CUSTOM_SYS_INIT_SP_ADDR=y
CONFIG_CUSTOM_SYS_INIT_SP_ADDR=0x82300000
CONFIG_DEFAULT_DEVICE_TREE="cv1800b-milkv-duo"
CONFIG_IDENT_STRING="cvitek_cv180x"
CONFIG_SYS_LOAD_ADDR=0x80300000
CONFIG_TARGET_MILKV_DUO=y
CONFIG_ARCH_RV64I=y
CONFIG_RISCV_SMODE=y
CONFIG_FIT=y
CONFIG_SUPPORT_RAW_INITRD=y
CONFIG_BOOTDELAY=1
CONFIG_USE_BOOTCOMMAND=y
CONFIG_BOOTCOMMAND="run distro_bootcmd"
CONFIG_HUSH_PARSER=y
CONFIG_SYS_PROMPT="milkv_duo# "
CONFIG_BOOTM_OPENRTOS=y
CONFIG_CMD_MMC=y
CONFIG_CMD_PART=y
CONFIG_CMD_DHCP=y
CONFIG_CMD_PXE=y
CONFIG_CMD_SYSBOOT=y
CONFIG_CMD_FAT=y
CONFIG_CMD_FS_GENERIC=y
CONFIG_NET_RANDOM_ETHADDR=y
CONFIG_MMC=y
CONFIG_MMC_IO_VOLTAGE=y
CONFIG_MMC_UHS_SUPPORT=y
CONFIG_MMC_SDHCI=y
CONFIG_MMC_SDHCI_SDMA=y
CONFIG_MMC_SDHCI_CVITEK=y
CONFIG_PHY_CVITEK=y
CONFIG_ETH_DESIGNWARE=y
CONFIG_SYS_NS16550=y
CONFIG_SPI=y
CONFIG_FS_EXT4=y
CONFIG_FAT_WRITE=y
CONFIG_ZSTD=y
# CONFIG_EFI_LOADER is not set
```
